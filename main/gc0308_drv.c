// GC0308 传感器驱动（裸 I2C，不依赖 esp32-camera 组件）
//
// 寄存器表来自 esp32-camera 组件的 gc0308_settings.h（Apache-2.0），
// 保留在 managed_components/ 里作为学习对照，不参与编译。

#include "gc0308_drv.h"
#include "i2c_bus.h"

#include "esp_log.h"
#include "freertos/FreeRTOS.h"
#include "freertos/task.h"

static const char *TAG = "gc0308";

static i2c_master_dev_handle_t s_dev = NULL;

// GC0308 常用寄存器
#define REG_PAGE_SEL    0xFE  // 页选择；写 0xF0 为软复位
#define REG_PID         0x00  // 芯片 ID
#define REG_OUTPUT_FMT  0x24  // 输出格式，低 4 位：0x06=RGB565
#define REG_CISCTL_MODE 0x14  // bit0=水平镜像，bit1=垂直翻转
#define REG_SUBSAMPLE_EN  0x53  // 页1：bit7=子采样使能
#define REG_SUBSAMPLE_MODE 0x54 // 页1：0x22 = 1/2 缩放
#define REG_SUBSAMPLE_EN2  0x55  // 页1：bit0=子采样使能2
#define REG_SUBSAMPLE_Y0 0x56
#define REG_SUBSAMPLE_Y1 0x57
#define REG_SUBSAMPLE_UV0 0x58
#define REG_SUBSAMPLE_UV1 0x59

// ---- I2C 基础读写：SCCB 就是标准 I2C，寄存器地址 8 位 ----
static esp_err_t reg_write(uint8_t reg, uint8_t val)
{
    uint8_t buf[2] = {reg, val};
    return i2c_master_transmit(s_dev, buf, sizeof(buf), 100);
}

static esp_err_t reg_read(uint8_t reg, uint8_t *val)
{
    return i2c_master_transmit_receive(s_dev, &reg, 1, val, 1, 100);
}

// 读-改-写：只修改 mask 指定的位，避免覆盖寄存器其他配置
static esp_err_t reg_set_bits(uint8_t reg, uint8_t mask, uint8_t value)
{
    uint8_t cur = 0;
    esp_err_t ret = reg_read(reg, &cur);
    if (ret != ESP_OK) {
        return ret;
    }
    return reg_write(reg, (uint8_t)((cur & ~mask) | (value & mask)));
}

// ---- GC0308 默认初始化寄存器表（来自组件，顺序不可打乱） ----
static const uint8_t gc0308_default_regs[][2] = {
    {0xFE, 0x00}, {0xEC, 0x20}, {0x05, 0x00}, {0x06, 0x00}, {0x07, 0x00}, {0x08, 0x00}, {0x09, 0x01}, {0x0A, 0xE8},
    {0x0B, 0x02}, {0x0C, 0x88}, {0x0D, 0x02}, {0x0E, 0x02}, {0x10, 0x26}, {0x11, 0x0D}, {0x12, 0x2A}, {0x13, 0x00},
    {0x14, 0x10}, {0x15, 0x0A}, {0x16, 0x05}, {0x17, 0x01}, {0x18, 0x44}, {0x19, 0x44}, {0x1A, 0x2A}, {0x1B, 0x00},
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    {0xE6, 0x01}, {0xE7, 0xE0}, {0xE8, 0x01}, {0xE9, 0xE0}, {0xEA, 0x01}, {0xEB, 0xE0}, {0xFE, 0x00},
};

static esp_err_t reg_write_table(const uint8_t regs[][2], size_t count)
{
    for (size_t i = 0; i < count; i++) {
        esp_err_t ret = reg_write(regs[i][0], regs[i][1]);
        if (ret != ESP_OK) {
            return ret;
        }
    }
    return ESP_OK;
}

esp_err_t gc0308_drv_init(void)
{
    esp_err_t ret;

    i2c_bus_init();
    if (!s_dev) {
        s_dev = i2c_bus_add_device(GC0308_I2C_ADDR);
        if (!s_dev) {
            ESP_LOGE(TAG, "add I2C device 0x%02x failed", GC0308_I2C_ADDR);
            return ESP_FAIL;
        }
    }

    // 1. 软件复位
    ret = reg_write(REG_PAGE_SEL, 0xF0);
    if (ret != ESP_OK) {
        ESP_LOGE(TAG, "software reset failed: 0x%x", ret);
        return ret;
    }
    vTaskDelay(pdMS_TO_TICKS(80));

    // 2. 写默认寄存器表
    ret = reg_write_table(gc0308_default_regs,
                          sizeof(gc0308_default_regs) / sizeof(gc0308_default_regs[0]));
    if (ret != ESP_OK) {
        ESP_LOGE(TAG, "default regs failed: 0x%x", ret);
        return ret;
    }
    vTaskDelay(pdMS_TO_TICKS(80));
    reg_write(REG_PAGE_SEL, 0x00);

    // 3. 读 PID 确认芯片
    uint8_t pid = 0;
    ret = reg_read(REG_PID, &pid);
    if (ret != ESP_OK || pid != GC0308_PID) {
        ESP_LOGE(TAG, "PID mismatch: expected 0x%02x, got 0x%02x", GC0308_PID, pid);
        return ESP_ERR_NOT_FOUND;
    }

    // 4. QVGA(320x240)：保持 VGA 窗口，用传感器内部 1/2 子采样输出
    //    窗口尺寸 = 分辨率 + 8（GC0308 硬件要求），VGA 窗口即 648x488
    static const uint8_t qvga_page0[][2] = {
        {0x05, 0x00}, {0x06, 0x00},  // ROW_START = 0
        {0x07, 0x00}, {0x08, 0x00},  // COL_START = 0
        {0x09, 0x01}, {0x0a, 0xE8},  // WIN_HEIGHT = 488
        {0x0b, 0x02}, {0x0c, 0x88},  // WIN_WIDTH  = 648
    };
    ret = reg_write_table(qvga_page0, sizeof(qvga_page0) / sizeof(qvga_page0[0]));
    if (ret != ESP_OK) {
        return ret;
    }

    ret = reg_write(REG_PAGE_SEL, 0x01);             // 切到页 1
    ret |= reg_set_bits(REG_SUBSAMPLE_EN, 0x80, 0x80);   // bit7 = 1：使能子采样
    ret |= reg_set_bits(REG_SUBSAMPLE_EN2, 0x01, 0x01);  // bit0 = 1：使能子采样 2
    ret |= reg_write(REG_SUBSAMPLE_MODE, 0x22);          // 1/2 缩放
    ret |= reg_write(REG_SUBSAMPLE_Y0, 0x00);
    ret |= reg_write(REG_SUBSAMPLE_Y1, 0x00);
    ret |= reg_write(REG_SUBSAMPLE_UV0, 0x00);
    ret |= reg_write(REG_SUBSAMPLE_UV1, 0x00);
    ret |= reg_write(REG_PAGE_SEL, 0x00);                // 回到页 0
    if (ret != ESP_OK) {
        ESP_LOGE(TAG, "QVGA subsample config failed: 0x%x", ret);
        return ret;
    }

    // 5. 输出格式 RGB565（只改低 4 位，保留高 4 位原有配置）
    ret = reg_set_bits(REG_OUTPUT_FMT, 0x0F, 0x06);
    if (ret != ESP_OK) {
        ESP_LOGE(TAG, "set RGB565 failed: 0x%x", ret);
        return ret;
    }

    // 6. 水平镜像，匹配屏幕方向（只改 bit0）
    ret = reg_set_bits(REG_CISCTL_MODE, 0x01, 0x01);
    if (ret != ESP_OK) {
        return ret;
    }

    ESP_LOGI(TAG, "GC0308 OK, PID=0x%02x", pid);
    return ESP_OK;
}
